## meta-rockM/conf/distro/rockM.conf
```bitbake
DISTROOVERRIDES =. "poky:"

require conf/distro/poky.conf

DISTRO = "rockM"
DISTRO_NAME = "rockM"
DISTRO_VERSION = "1.0"
DISTRO_CODENAME = "one"

INIT_MANAGER = "systemd"

DISTRO_FEATURES:append = " systemd pci wifi"
```

## meta-rockM/conf/layer.conf
```bitbake
# We have a conf and classes directory, add to BBPATH
BBPATH .= ":${LAYERDIR}"

# We have recipes-* directories, add to BBFILES
BBFILES += "${LAYERDIR}/recipes-*/*/*.bb \
            ${LAYERDIR}/recipes-*/*/*.bbappend"

BBFILE_COLLECTIONS += "meta-rockM"
BBFILE_PATTERN_meta-rockM = "^${LAYERDIR}/"
BBFILE_PRIORITY_meta-rockM = "9"

LAYERDEPENDS_meta-rockM = "core"
LAYERSERIES_COMPAT_meta-rockM = "scarthgap"
```

## meta-rockM/conf/machine/rock-5bx.conf
```bitbake
SOC_FAMILY ?= "rk3588"
MACHINEOVERRIDES =. "rock-5bx:"
DEFAULTTUNE ?= "cortexa76-cortexa55-crypto"

require conf/machine/include/rk3588.inc

#PREFERRED_PROVIDER_virtual/kernel = "linux-rockchip"
#PREFERRED_PROVIDER_virtual/kernel = "linux-rockchipx"
PREFERRED_PROVIDER_virtual/kernel = "linux-rockchip-armbian"

PREFERRED_PROVIDER_virtual/bootloader ?= "u-boot"

KERNEL_DEVICETREE = "rockchip/rk3588-rock-5b.dtb"
MACHINE_EXTRA_RRECOMMENDS += "kernel-modules"

UBOOT_MACHINE = "rock5b-rk3588_defconfig"

KERNEL_IMAGETYPE = "Image"

KERNEL_DEVICETREE = "rockchip/rk3588-rock-5b.dtb"

MACHINE_ESSENTIAL_EXTRA_RDEPENDS += "kernel-devicetree"

# misc
SERIAL_CONSOLES ?= "1500000;ttyS2"
RK_CONSOLE_BAUD ?= "${@d.getVar('SERIAL_CONSOLES').split(';')[0]}"
RK_CONSOLE_DEVICE ?= "${@d.getVar('SERIAL_CONSOLES').split(';')[1].split()[0]}"

# Discoverable Partitions Specification (DPS)
ROOT_DPS:arm = "69dad710-2ce4-4e3c-b16c-21a1d49abed3"
ROOT_DPS:aarch64 = "b921b045-1df0-41c3-af44-4c6f280d3fae"


KBUILD_DEFCONFIG ?= "defconfig"
KERNEL_FEATURES:append:rock-5bx = " bsp/rockchip/remove-non-rockchip-arch-arm64.scc"
KERNEL_CLASSES = "kernel-fitimage"
KERNEL_IMAGETYPE ?= "fitImage"

UBOOT_SUFFIX ?= "itb"
UBOOT_ENTRYPOINT ?= "0x06000000"

ENABLE_STATELESS_VPU_GST ?= "1"
```
